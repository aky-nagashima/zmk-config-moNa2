## config/west.yml
```yaml
manifest:
  remotes:
    - name: zmkfirmware
      url-base: https://github.com/petejohanson
    - name: sayu-hub
      url-base: https://github.com/sayu-hub
    - name: caksoylar  # <-- new entry
      url-base: https://github.com/caksoylar 
    - name: englmaxi
      url-base: https://github.com/englmaxi
    - name: carrefinho
      url-base: https://github.com/carrefinho 
  projects:
    - name: zmk
      remote: zmkfirmware
      revision: feat/pointers-move-scroll
      import: app/west.yml
    - name: zmk-pmw3610-driver
      remote: sayu-hub
      revision: main
    - name: zmk-rgbled-widget  # <-- new entry
      remote: caksoylar
      revision: main
    - name: zmk-hid-trackball-interface
      remote: englmaxi
      revision: main
    - name: prospector-zmk-module
      remote: carrefinho
      revision: main
  self:
    path: config
    
```
